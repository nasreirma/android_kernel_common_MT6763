## drivers/input/fingerprint/sunwave_fp/Kconfig
```kconfig
config MTK_FINGERPRINT_SUNWAVE
	bool "sunwave(sunwave fingerprint sensor)  for dewav"
	default n
	help
	It support different type sensor
	in this platform. If this option
	is set, it will support fingerprint sunwave silead sensor .
```

## drivers/misc/mediatek/tkcore/Kconfig
```kconfig
# Trusted Execution Environment Configuration
config TRUSTKERNEL_TEE_SUPPORT
	bool "TrustKernel Trusted Execution Environment Support"
	default n
	---help---
	  This implements TrustKernel TKcore Linux Driver.

config TRUSTKERNEL_TEE_RPMB_SUPPORT
	bool "TrustKernel Trusted Execution Environment RPMB Support"
	default n
	---help---
	  This implements TrustKernel TKcore Linux Driver Replay Protected
	  Memory Block function.
```
